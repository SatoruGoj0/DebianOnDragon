// SPDX-License-Identifier: BSD-3-Clause
/*
 * Lenovo IdeaPad Slim 3 15Q8X10 (83N3).
 *
 * Kept so a system whose /etc/default/debondragon still points at
 * qcom/x1p42100-lenovo-ideapad-slim3-15q8x10-speakers.dtb boots the same
 * audio hardware as the default board. Speakers are no longer a separate
 * opt-in: the shared dtsi enables the two WSA8845 amplifiers.
 */

/dts-v1/;

#include "x1p42100-lenovo-ideapad-slim3-15q8x10.dtsi"
