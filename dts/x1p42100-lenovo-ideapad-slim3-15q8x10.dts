// SPDX-License-Identifier: BSD-3-Clause
/*
 * Lenovo IdeaPad Slim 3 15Q8X10 (83N3): default board.
 * Headphones, headset microphone, internal microphones and the two
 * internal WSA8845 speakers (SoundWire 0).
 */

/dts-v1/;

#include "x1p42100-lenovo-ideapad-slim3-15q8x10.dtsi"
